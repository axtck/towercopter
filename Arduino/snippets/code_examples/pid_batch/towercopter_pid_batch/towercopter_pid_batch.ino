
#include <Servo.h>
#include <PID_v1.h>

Servo ESC;                                           // create servo object to control the ESC

// ESC
float potValue;                                      // value from the analog pin
float potValue1;
float u;

// SENSOR
const int Trigger = 6;                               // Digital pin 6 for Trigger
const int Echo = 5;                                  // Digital pin 5 for Echo
const int sw_am_pin = 13;                            // Digital pin 7 for sw_am
float potValuef=0;
float alpha;
float df;

// PID
double Setpoint ;                                   
double Input;                                       
double Inputf;                                       
double Output ;                                     
double Kp=0.1, Ki=0.1, Kd=0.01;                      // PID tuning parameters
PID myPID(&Input, &Output, &Setpoint, Kp, Ki, Kd, DIRECT); // myPID Object
bool sw_am;                                           // Sw auto/manual
int umax = 90;                                        // ESC max value
int umin = 0;                                         // ESC min value

// Batch
int batch[300] = {0,0,0,0,0,0,0,0,0,0,0,0,0,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0,0}; 
float sinebatch[300] = {50,50,50,50,50,50,50,50,50,50,50,50,50,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0.654222093967562,0.0958986010301857};
int sw_batch = 2;

int cont=0;
int cont2=0;
int largo_batch = 300;

void setup() {

  // ESC

  ESC.attach(9,1000,2000);                            // Attach the ESC on pin 9, (pin, min pulse width, max pulse width in microseconds) 
  Serial.begin(9600);
  ESC.write(0);                                       // Send the signal to the ESC
  delay(5000);
  // SENSOR 
  pinMode(Trigger, OUTPUT);                           // Pin as output
  pinMode(Echo, INPUT);                               // Pin as input
  pinMode(sw_am_pin, INPUT);                          // Pin as input
  digitalWrite(Trigger, LOW);                         // Trigger initialization at zero
  digitalWrite(sw_am_pin, LOW);                       // Se_am_pin initialization at zero

  // PID
  Setpoint = 0;
  myPID.SetMode(AUTOMATIC);                           // Turn the PID on
  myPID.SetTunings(Kp, Ki, Kd);                       // Adjust PID values


}

void loop() {
 
  // SENSOR 
  digitalWrite(Trigger, LOW);
  delayMicroseconds(2);
  digitalWrite(Trigger, HIGH);
  delayMicroseconds(10);                               // 10ms pulse

  float t = pulseIn(Echo, HIGH);                       // Pulse width
  float d = (t/2)/29.1;                                // Distance in cm

  // PID

  Input = map(d,5,44,0,100);                           // Maps sensor value to input for PID
  alpha = 0.05 ;                                       // Lowpass filter
  df = (alpha*d)+((1-alpha)*df);                       // Lowpass filter
  Inputf = map(df,5,44,0,100);                         // Maps filtered sensor value to input for PID
  
  sw_am = digitalRead(sw_am_pin);                      // Sw auto/manual

  if (sw_am == HIGH)                                   // Auto
  {
   potValue = analogRead(A0);                          // Reads the value of the potentiometer (value between 0 and 1023)
   alpha = 0.05;                                       // Lowpass filter
   potValuef = (alpha*potValue)+((1-alpha)*potValuef); // Lowpass filter
   if (cont >= largo_batch)
   {
      Setpoint = 0;   
      ESC.write(0);                                       // Send the signal to the ESC    

   }
   else
   {
       if (sw_batch == 1)
        {
          Setpoint = batch[cont];            // Maps pot value to Setpoint
        }
       else
       {
          Setpoint = sinebatch[cont];            // Maps pot value to Setpoint  
       }
      
      cont2 = cont2+1;
      if (cont2 == 15)
      {
        cont2 = 0;
        cont = cont+1;
        }
      myPID.Compute();                                    // Computes control effort
      u = map(Output,0,100,umin,umax);                    // Maps control effort to ESC control values
      if (u>=umax)                                        // Max limit
      {
       u = umax;
       }
      ESC.write(u);                                       // Send the signal to the ESC    
   }
  
  }
  else  // manual
  {
   potValue = analogRead(A0);                          // Reads the value of the potentiometer (value between 0 and 1023)
   alpha = 0.05;                                       // Lowpass filter
   potValuef = (alpha*potValue)+((1-alpha)*potValuef); // Lowpass filter
   u = map(potValuef,30,1000,umin,umax);               // Maps pot to ESC control values. 
   if (u >= umax)                                      // Max limit
   {
      u = umax;
   } 
   ESC.write(u);                                        // Send the signal to the ESC
   }
  
  // Plots
  Serial.print(" ");
  Serial.print(Setpoint);
  Serial.print(" ");
  Serial.print(Input); 
  Serial.print(" ");
  Serial.print(Output); 

 // Plotter limits
  Serial.print(" ");
  Serial.print(0);                                      // To freeze the lower limit
  Serial.print(" ");
  Serial.print(100);                                    // To freeze the upper limit
  Serial.println(" ");
  
  delay(0.1);
  
}
